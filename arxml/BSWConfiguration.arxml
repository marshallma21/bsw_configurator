AUTOSAR XML (schema 4-3-0)
package /BSWConfiguration
  ecuc value collection s32k144evb: ecu-extract=MyAUTOSAREcuExtract, ecuc-values=[IoHwAb, EcuC, CanIf, PduR, Com, Can, Pwm, Mcu, Mcl, Resource, Base, Port, Adc, Os, EcuM, Det, Rte, Dio]
  module config IoHwAb: implementation-config-variant=VARIANT-PRE-COMPILE, module-description=IoHwAb
    ArcIoHwAbGeneral: ArcIoHwAbDevErrorDetect=true, ArcIoHwAbAnalogMaxVoltage=5.0, ArcIoHwAbUsePort=false, ArcIoHwCalibrationEnabled=false
    SwtCCW (ArcIoHwAbDigitalSignal):
      ArcIoHwAbDigitalDefaultValue = IOHWAB_LOW
      ArcIoHwAbDigitalInverted = false
      ArcIoHwAbDigitalMethod = IOHWAB_DIGITAL_READ
      ArcIoHwAbDigitalType = IOHWAB_DIO
      ArcIoHwAbDioChannelRef = Dio_SWT_CCW
    RelayA (ArcIoHwAbDigitalSignal):
      ArcIoHwAbDigitalDefaultValue = IOHWAB_HIGH
      ArcIoHwAbDigitalInverted = false
      ArcIoHwAbDigitalMethod = IOHWAB_DIGITAL_WRITE
      ArcIoHwAbDigitalType = IOHWAB_DIO
      ArcIoHwAbDioChannelRef = Dio_RelayA
    Sensor (ArcIoHwAbAnalogSignal):
      ArcIoHwAbAnalogDefaultValue = 0.0
      ArcIoHwAbAnalogSignalResolution = 8_BIT_RESOLUTION
      ArcIoHwAbAnalogType = IOHWAB_ADC
      ArcIoHwAbScalingRef = ArcIoHwAbScaling
      ArcIoHwAbAdcChannel = AdcPotChannel
      ArcIoHwAbAdcGroup = AdcGroup_0
    ArcIoHwAbScaling: ArcIoHwAbScalingOffset=0.0, ArcIoHwAbScalingScale=1.0, ArcIoHwAbScalingType=Volt
    SwtCW (ArcIoHwAbDigitalSignal):
      ArcIoHwAbDigitalDefaultValue = IOHWAB_LOW
      ArcIoHwAbDigitalInverted = false
      ArcIoHwAbDigitalMethod = IOHWAB_DIGITAL_READ
      ArcIoHwAbDigitalType = IOHWAB_DIO
      ArcIoHwAbDioChannelRef = Dio_SWT_CW
    RelayB (ArcIoHwAbDigitalSignal):
      ArcIoHwAbDigitalDefaultValue = IOHWAB_HIGH
      ArcIoHwAbDigitalInverted = false
      ArcIoHwAbDigitalMethod = IOHWAB_DIGITAL_WRITE
      ArcIoHwAbDigitalType = IOHWAB_DIO
      ArcIoHwAbDioChannelRef = Dio_RelayB
    ArcIoHwAbAnalogSignal: ArcIoHwAbAnalogDefaultValue=0.0, ArcIoHwAbAnalogSignalResolution=, ArcIoHwAbAnalogType=IOHWAB_ADC, ArcIoHwAbScalingRef=(unset)
  module config EcuC: implementation-config-variant=VARIANT-PRE-COMPILE, module-description=EcuC
    EcucPduCollection: PduIdTypeEnum=, PduLengthTypeEnum=
      4 x Pdu, all with PduLength=8:
        ECU01_01_3FE
        MyECU_01_3FF
        ECU1_01_3FE
        ECU2_01_3FF
  module config CanIf: implementation-config-variant=VARIANT-PRE-COMPILE, module-description=CanIf
    CanIfCtrlDrvCfg: CanIfCtrlDrvTxCancellation=false, CanIfCtrlDrvInitHohConfigRef=CanIfInitHohCfg, CanIfCtrlDrvNameRef=(unset)
      CanIfCtrlCfg: CanIfCtrlId=, CanIfCtrlWakeupSupport=false, CanIfCtrlCanCtrlRef=CanController_0
    CanIfInitCfg: CanIfInitCfgSet=
      ECU01_01_3FE (CanIfRxPduCfg):
        CanIfRxPduCanIdType = STANDARD_CAN
        CanIfRxPduDlc = 8
        CanIfRxPduId = 
        CanIfRxPduReadData = false
        CanIfRxPduReadNotifyStatus = false
        CanIfRxPduCanId = 1022
        CanIfRxPduUserRxIndicationUL = PDUR
        CanIfRxPduBswSchExclAreaIdRef = (unset)
        CanIfRxPduHrhIdRef = CanIfHrhCfg
        CanIfRxPduRef = EcucPduCollection/ECU01_01_3FE
      MyECU_01_3FF (CanIfTxPduCfg):
        CanIfTxPduCanId = 1023
        CanIfTxPduCanIdType = STANDARD_CAN
        CanIfTxPduDlc = 8
        CanIfTxPduId = 
        CanIfTxPduReadNotifyStatus = false
        CanIfTxPduType = STATIC
        CanIfTxPduUserTxConfirmationUL = PDUR
        CanIfTxPduBswSchExclAreaIdRef = (unset)
        CanIfTxPduBufferRef = CanIfBufferCfg
        CanIfTxPduRef = EcucPduCollection/MyECU_01_3FF
      CanIfInitHohCfg: CanIfInitRefCfgSet=(unset)
        CanIfHrhCfg: CanIfHrhSoftwareFilter=true, CanIfHrhCanCtrlIdRef=CanIfCtrlCfg, CanIfHrhIdSymRef=CanHardwareObject_0
        CanIfHthCfg: CanIfHthCanCtrlIdRef=CanIfCtrlCfg, CanIfHthIdSymRef=CanHardwareObject_1
      CanIfBufferCfg: CanIfBufferSize=0, CanIfBufferHthRef=CanIfHthCfg
      ECU1_01_3FE (CanIfRxPduCfg):
        CanIfRxPduCanIdType = STANDARD_CAN
        CanIfRxPduDlc = 8
        CanIfRxPduId = 
        CanIfRxPduReadData = false
        CanIfRxPduReadNotifyStatus = false
        CanIfRxPduCanId = 1022
        CanIfRxPduBswSchExclAreaIdRef = (unset)
        CanIfRxPduHrhIdRef = (unset)
        CanIfRxPduRef = EcucPduCollection/ECU1_01_3FE
      ECU2_01_3FF (CanIfTxPduCfg):
        CanIfTxPduCanId = 1023
        CanIfTxPduCanIdType = STANDARD_CAN
        CanIfTxPduDlc = 8
        CanIfTxPduId = 
        CanIfTxPduReadNotifyStatus = false
        CanIfTxPduType = 
        CanIfTxPduBswSchExclAreaIdRef = (unset)
        CanIfTxPduBufferRef = (unset)
        CanIfTxPduRef = EcucPduCollection/ECU2_01_3FF
    CanIfPrivateCfg: CanIfPrivateDlcCheck=true, CanIfPrivateSoftwareFilterType=LINEAR, CanIfSupportTTCAN=false
    CanIfPublicCfg:
      CanIfPublicCancelTransmitSupport = false
      CanIfPublicChangeBaudrateSupport = false
      CanIfPublicDevErrorDetect = true
      CanIfPublicHandleTypeEnum = 
      CanIfPublicMultipleDrvSupport = true
      CanIfPublicNumberOfCanHwUnits = 1
      CanIfPublicPnSupport = false
      CanIfPublicReadRxPduDataApi = false
      CanIfPublicReadRxPduNotifyStatusApi = false
      CanIfPublicReadTxPduNotifyStatusApi = false
      CanIfPublicSetDynamicTxIdApi = false
      CanIfPublicTxBuffering = false
      CanIfPublicTxConfirmPollingSupport = false
      CanIfPublicVersionInfoApi = false
      CanIfPublicWakeupCheckValidSupport = false
      ArcCanIfPublicTxBufferSize = 0
      ArcCanIfPublicMaxNumberOfTxBuffers = 0
      ArcCanIfOsekNmSupport = false
      ArcCanIfCanFDSupport = false
    CanIfDispatchCfg:
      CanIfDispatchUserConfirmPnAvailabilityName = 
      CanIfDispatchUserConfirmPnAvailabilityUL = 
      CanIfDispatchUserCtrlBusOffUL = 
      CanIfDispatchUserCtrlModeIndicationUL = 
  module config PduR: implementation-config-variant=VARIANT-PRE-COMPILE, module-description=PduR
    PduRGeneral: PduRDevErrorDetect=true, PduRVersionInfoApi=false, PduRZeroCostOperation=false
    PduRRoutingTables: PduRConfigurationId=0, ArcPduRMaxRouteCount=30
      PduRRoutingTable: PduRIsMinimumRouting=false
        4 x PduRRoutingPath:
          ECU01_01_3FE
            PduRDestPdu: ArcOverridenDestModule=Com, PduRDestPduRef=EcucPduCollection/ECU01_01_3FE
            PduRSrcPdu: PduRSourcePduHandleId=, ArcOverridenSrcModule=CanIf, PduRSrcPduRef=EcucPduCollection/ECU01_01_3FE
          MyECU_01_3FF
            PduRDestPdu: ArcOverridenDestModule=CanIf, PduRDestPduRef=EcucPduCollection/MyECU_01_3FF
            PduRSrcPdu: PduRSourcePduHandleId=, ArcOverridenSrcModule=Com, PduRSrcPduRef=EcucPduCollection/MyECU_01_3FF
          ECU1_01_3FE
            PduRDestPdu: ArcOverridenDestModule=Com, PduRDestPduRef=EcucPduCollection/ECU1_01_3FE
            PduRSrcPdu: PduRSourcePduHandleId=, ArcOverridenSrcModule=CanIf, PduRSrcPduRef=EcucPduCollection/ECU1_01_3FE
          ECU2_01_3FF
            PduRDestPdu: ArcOverridenDestModule=CanIf, PduRDestPduRef=EcucPduCollection/ECU2_01_3FF
            PduRSrcPdu: PduRSourcePduHandleId=, ArcOverridenSrcModule=Com, PduRSrcPduRef=EcucPduCollection/ECU2_01_3FF
    CanIf (PduRBswModules):
      PduRCancelReceive = false
      PduRCancelTransmit = 
      PduRChangeParameterRequestApi = 
      PduRCommunicationInterface = 
      PduRLowerModule = 1
      PduRRetransmission = 
      PduRTransportProtocol = 
      PduRTriggertransmit = 
      PduRTxConfirmation = 
      PduRUpperModule = 0
      PduRUseTag = 
      PduRBswModuleRef = (unset)
    Com (PduRBswModules):
      PduRCancelReceive = false
      PduRCancelTransmit = 
      PduRChangeParameterRequestApi = 
      PduRCommunicationInterface = 
      PduRLowerModule = 0
      PduRRetransmission = 
      PduRTransportProtocol = 
      PduRTriggertransmit = 
      PduRTxConfirmation = 
      PduRUpperModule = 1
      PduRUseTag = 
      PduRBswModuleRef = (unset)
  module config Com: implementation-config-variant=VARIANT-PRE-COMPILE, module-description=Com
    ComConfig: ComConfigurationId=
      ComTimeBase: ComRxTimeBase=0.01, ComTxTimeBase=0.01
      IntReq (ComSignal):
        ComBitPosition = 0
        ComHandleId = 
        ComSignalEndianness = BIG_ENDIAN
        ComSignalType = UINT8
        ComBitSize = 8
        ComSignalInitValue = 0
        ComSystemTemplateSystemSignalRef = IntReqMapping
      ECU01_01_3FE (ComIPdu):
        ComIPduDirection = RECEIVE
        ComIPduSignalProcessing = DEFERRED
        ComIPduTriggerTransmitCallout = 
        ComIPduType = 
        ComPduIdRef = EcucPduCollection/ECU01_01_3FE
        ComIPduSignalRef = IntReq
        ComIPduGroupRef = ComIPduGroupRx
      LEDSts (ComSignal):
        ComBitPosition = 39
        ComHandleId = 
        ComSignalEndianness = BIG_ENDIAN
        ComSignalType = BOOLEAN
        ComBitSize = 1
        ComSignalInitValue = 0
        ComSystemTemplateSystemSignalRef = LEDStsMapping
      PotValue (ComSignal):
        ComBitPosition = 0
        ComHandleId = 
        ComSignalEndianness = BIG_ENDIAN
        ComSignalType = UINT8
        ComBitSize = 8
        ComSignalInitValue = 0
        ComSystemTemplateSystemSignalRef = PotValueMapping
      MyECU_01_3FF (ComIPdu):
        ComIPduDirection = SEND
        ComIPduSignalProcessing = DEFERRED
        ComIPduTriggerTransmitCallout = 
        ComIPduType = 
        ComPduIdRef = EcucPduCollection/MyECU_01_3FF
        ComIPduSignalRef = LEDSts
        ComIPduSignalRef = PotValue
        ComIPduGroupRef = ComIPduGroupTx
        ComTxIPdu: ComTxIPduUnusedAreasDefault=0
          ComTxModeTrue
            ComTxMode: ComTxModeMode=PERIODIC, ComTxModeTimePeriod=0.1
      ComIPduGroupRx (ComIPduGroup): ComIPduGroupHandleId=
      ComIPduGroupTx (ComIPduGroup): ComIPduGroupHandleId=
      SEAT_MEM_REQ_POS (ComSignal): ComBitPosition=8, ComHandleId=, ComSignalEndianness=BIG_ENDIAN, ComSignalType=UINT8, ComBitSize=8
      SEAT_MEM_Req (ComSignal): ComBitPosition=0, ComHandleId=, ComSignalEndianness=BIG_ENDIAN, ComSignalType=UINT8, ComBitSize=8
      ECU1_01_3FE (ComIPdu):
        ComIPduDirection = RECEIVE
        ComIPduSignalProcessing = 
        ComIPduTriggerTransmitCallout = 
        ComIPduType = 
        ComPduIdRef = EcucPduCollection/ECU1_01_3FE
        ComIPduSignalRef = SEAT_MEM_REQ_POS
        ComIPduSignalRef = SEAT_MEM_Req
      SEAT_POS (ComSignal): ComBitPosition=0, ComHandleId=, ComSignalEndianness=BIG_ENDIAN, ComSignalType=UINT8, ComBitSize=8
      ECU2_01_3FF (ComIPdu):
        ComIPduDirection = SEND
        ComIPduSignalProcessing = 
        ComIPduTriggerTransmitCallout = 
        ComIPduType = 
        ComPduIdRef = EcucPduCollection/ECU2_01_3FF
        ComIPduSignalRef = SEAT_POS
    ComGeneral:
      ComSupportedIPduGroups = 4
      ComVersionInfoApi = false
      ComSupportedIPdus = 20
      ComSupportedSignals = 40
      ComSupportedGroupSignals = 40
      ComRamBufferSize = 150
      ArcMaxNumberOfSupportedIPduCounters = 10
      ArcComSupportedGatewaySourceDescriptions = 1
      ArcComOsekNmSupport = false
  module config Can: implementation-config-variant=VARIANT-PRE-COMPILE
    CanConfigSet
      CanController_0 (CanController):
        CanAutoBusOffRecovery = 0
        CanBccSupport = 0
        CanBusoffProcessing = POLLING
        CanClockFromBus = 1
        CanControllerActivation = 1
        CanControllerBaseAddress = 0
        CanControllerIcomSupported = 0
        CanControllerId = 0
        CanControllerRxFifoEnable = 0
        CanErrorControllerNotifEn = 1
        CanErrorControllerNotification = NULL_PTR
        CanHwChannel = FlexCAN_A
        CanListenOnlyMode = 0
        CanLocalPriorityEn = 0
        CanLoopBackMode = 0
        CanLowestBuffTransmitFirst = 1
        CanRxFifoOverflowNotification = NULL_PTR
        CanRxFifoWarningNotification = NULL_PTR
        CanRxProcessing = POLLING
        CanSoftwareBusOffRecovery = 0
        CanTrippleSamplingEnable = 0
        CanTxProcessing = POLLING
        CanWakeUpSourceFilter = 0
        CanWakeupFunctionalityAPI = 0
        CanWakeupProcessing = POLLING
        CanWakeupSupport = 0
        CanControllerDefaultBaudrate = CanControllerBaudrateConfig_0
        CanCpuClockRef = McuClockReferencePoint_SIRC_CLK
        CanControllerBaudrateConfig_0 (CanControllerBaudrateConfig):
          CanAdvancedSetting = 0
          CanBusLength = 40
          CanControllerBaudRate = 500
          CanControllerBaudRateConfigID = 0
          CanControllerCheckCanStandard = 1
          CanControllerPrescaller = 1
          CanControllerPrescaller_Alt = 100
          CanControllerPropSeg = 7
          CanControllerSeg1 = 4
          CanControllerSeg2 = 4
          CanControllerSyncJumpWidth = 4
          CanControllerSyncSeg = 1
          CanPropDelayTranceiver = 150.0
          CanTxArbitrationStartDelay = 12
          CanControllerCBT:
            CanControllerCbtBaudRate = 0
            CanControllerCbtEnable = 0
            CanControllerCbtPrescaller = 100
            CanControllerCbtPropSeg = 1
            CanControllerCbtSeg1 = 1
            CanControllerCbtSeg2 = 1
            CanControllerCbtSyncSeg = 1
            CanControllerSyncJumpWidthCbt = 1
        CanRxFifo: CanControllerIDAcceptanceMode=A, CanRxFifoFiltersNumber=FILTERS_NUMBER_8, CanRxFifoGlobalMaskValue=2047
      CanHardwareObject_0 (CanHardwareObject):
        CanHandleType = BASIC
        CanHwObjectCount = 1
        CanIdType = STANDARD
        CanMBPrio = 0
        CanObjectId = 0
        CanObjectType = RECEIVE
        CanControllerRef = CanController_0
        CanMainFunctionRWPeriodRef = CanMainFunctionRWPeriods_0
        CanHwFilter: CanHwFilterCode=0, CanHwFilterMask=0
      CanHardwareObject_1 (CanHardwareObject):
        CanHandleType = BASIC
        CanHwObjectCount = 1
        CanIdType = STANDARD
        CanMBPrio = 0
        CanObjectId = 1
        CanObjectType = TRANSMIT
        CanControllerRef = CanController_0
        CanMainFunctionRWPeriodRef = CanMainFunctionRWPeriods_0
    CanGeneral:
      CanAbortOnlyOneMB = 1
      CanAllowLoopAsCycle = 0
      CanApiEnableMbAbort = 0
      CanChangeBaudrateApi = 1
      CanCodeSizeOptimization = 0
      CanDevErrorDetection = 0
      CanEnableDualClockMode = 0
      CanEnableUserModeSupport = 0
      CanExtendedIDSupport = 1
      CanIndex = 0
      CanMBCountExtensionSupport = 1
      CanMainFunctionModePeriod = 0.01
      CanMaxMessageBuffers = 32
      CanMultiplexedTransmission = 1
      CanNumberOfTimeOutLoop = 1
      CanPublicIcomSupport = 0
      CanSpecifiedRAMBlockSize = 0
      CanTimeoutDuration = 0.1
      CanVersionInfoApi = 1
      MBDSR = CAN_8_BYTES_PAYLOAD
      CanOsCounterRef = OsCounter_0
      CanSupportTTCANRef = (unset)
      CanMainFunctionRWPeriods_0 (CanMainFunctionRWPeriods): CanMainFunctionPeriod=0.001
    CommonPublishedInformation:
      ArReleaseMajorVersion = 4
      ArReleaseMinorVersion = 2
      ArReleaseRevisionVersion = 2
      ModuleId = 80
      SwMajorVersion = 1
      SwMinorVersion = 0
      SwPatchVersion = 2
      VendorApiInfix = 
      VendorId = 43
  module config Pwm: implementation-config-variant=VARIANT-PRE-COMPILE
    CommonPublishedInformation:
      ArReleaseMajorVersion = 4
      ArReleaseMinorVersion = 2
      ArReleaseRevisionVersion = 2
      ModuleId = 121
      SwMajorVersion = 1
      SwMinorVersion = 0
      SwPatchVersion = 2
      VendorId = 43
    PwmChannelConfigSet
      PwmChannel_RedLed (PwmChannel):
        PwmChannelId = 0
        PwmDutycycleDefault = 16384
        PwmHwIP = FTM
        PwmIdleState = PWM_LOW
        PwmPeriodDefault = 0.01
        PwmPeriodInTicks = 0
        PwmPolarity = PWM_HIGH
        PwmFtmChannel = PwmFtmChannels_RedLed
        PwmMcuClockReferencePoint = McuClockReferencePoint_SYS_CLK
      PwmFtmModule_0 (PwmFtmModule):
        FtmModule = FTM_0
        PwmBDMEnable = CNT_ON_OUTPUTS_ON
        PwmChanEdgeAlignment = PWM_EDGE_ALIGNED
        PwmClockSelection = PWM_SYSTEM_CLOCK
        PwmFtmFaultFunctionality = FLTCTRL_DISABLED
        PwmPrescaler = PRESC_128
        PwmPrescaler_Alternate = PRESC_1
        PwmReloadFrequency = LDFQ_EACH1
        PwmUpdatedEndPeriod = 1
        PwmUpdatedMiddlePeriod = 0
        PwmExternalTriggerSettings:
          PwmEnableExternalTriggerChannel{0..7} = 0
          PwmEnableInitializationTrigger = 0
        PwmFtmChannelFaultSettings:
          PwmDisableOutputOnFault{0..3} = 0
          PwmFilterValue = 0
          PwmFtmFaultOutputState = SAFE_VALUES
          PwmFtmChannelFault{0..3}Settings: PwmEnableFault{0..3}Filter=0, PwmFault{0..3}Notification=NULL, PwmFault{0..3}Polarity=0
        PwmFtmChannels_RedLed (PwmFtmChannels): ChannelCombDeadTimeEn=0, ChannelEdgeSetup=INDEPENDENT, PwmFtmChannelId=FTM_0_CH_0, PwmPhaseShift=0
    PwmConfigurationOfOptApiServices:
      PwmDeInitApi = 1
      PwmDisableTrigger = 0
      PwmEnableTrigger = 0
      PwmForceOutputToZeroApi = 0
      PwmGetChannelStateApi = 0
      PwmGetOutputState = 0
      PwmSetDutyCycle = 1
      PwmSetDutyCycle_NoUpdate = 0
      PwmSetOutputToIdle = 1
      PwmSetPeriodAndDuty = 1
      PwmSetPeriodAndDuty_NoUpdate = 0
      PwmSetPhaseShift = 0
      PwmSetPhaseShiftNoUpdate = 0
      PwmSwResetCounter = 0
      PwmVersionInfoApi = 1
    PwmGeneral:
      EnableMaskingOperations = 0
      PwmDevErrorDetect = 0
      PwmDutycycleUpdatedEndperiod = 1
      PwmEnableDualClockMode = 0
      PwmEnablePhaseShift = 0
      PwmEnableUserModeSupport = 0
      PwmFaultSupport = 0
      PwmFtmEnableExtTrigger = 0
      PwmIndex = 0
      PwmMultiChannelSynch = 0
      PwmNotificationSupported = 1
      PwmPeriodUpdatedEndperiod = 1
      41 x PwmHwConfiguration, all with PwmInterruptEnable=0:
        PwmHwConfiguration_0: PwmChannelIsUsed=0, PwmInterruptHwId=PWM_FLEXIO_0_ISR
        PwmHwConfiguration_1: PwmChannelIsUsed=1, PwmInterruptHwId=PWM_FTM_0_CH_0_ISR
        PwmHwConfiguration_10: PwmChannelIsUsed=0, PwmInterruptHwId=PWM_FTM_0_FAULT_ISR
        PwmHwConfiguration_11: PwmChannelIsUsed=0, PwmInterruptHwId=PWM_FTM_1_CH_0_ISR
        PwmHwConfiguration_12: PwmChannelIsUsed=0, PwmInterruptHwId=PWM_FTM_1_CH_1_ISR
        PwmHwConfiguration_13: PwmChannelIsUsed=0, PwmInterruptHwId=PWM_FTM_1_CH_2_ISR
        PwmHwConfiguration_14: PwmChannelIsUsed=0, PwmInterruptHwId=PWM_FTM_1_CH_3_ISR
        PwmHwConfiguration_15: PwmChannelIsUsed=0, PwmInterruptHwId=PWM_FTM_1_CH_4_ISR
        PwmHwConfiguration_16: PwmChannelIsUsed=0, PwmInterruptHwId=PWM_FTM_1_CH_5_ISR
        PwmHwConfiguration_17: PwmChannelIsUsed=0, PwmInterruptHwId=PWM_FTM_1_CH_6_ISR
        PwmHwConfiguration_18: PwmChannelIsUsed=0, PwmInterruptHwId=PWM_FTM_1_CH_7_ISR
        PwmHwConfiguration_19: PwmChannelIsUsed=0, PwmInterruptHwId=PWM_FTM_1_TOF_ISR
        PwmHwConfiguration_2: PwmChannelIsUsed=0, PwmInterruptHwId=PWM_FTM_0_CH_1_ISR
        PwmHwConfiguration_20: PwmChannelIsUsed=0, PwmInterruptHwId=PWM_FTM_1_FAULT_ISR
        PwmHwConfiguration_21: PwmChannelIsUsed=0, PwmInterruptHwId=PWM_FTM_2_CH_0_ISR
        PwmHwConfiguration_22: PwmChannelIsUsed=0, PwmInterruptHwId=PWM_FTM_2_CH_1_ISR
        PwmHwConfiguration_23: PwmChannelIsUsed=0, PwmInterruptHwId=PWM_FTM_2_CH_2_ISR
        PwmHwConfiguration_24: PwmChannelIsUsed=0, PwmInterruptHwId=PWM_FTM_2_CH_3_ISR
        PwmHwConfiguration_25: PwmChannelIsUsed=0, PwmInterruptHwId=PWM_FTM_2_CH_4_ISR
        PwmHwConfiguration_26: PwmChannelIsUsed=0, PwmInterruptHwId=PWM_FTM_2_CH_5_ISR
        PwmHwConfiguration_27: PwmChannelIsUsed=0, PwmInterruptHwId=PWM_FTM_2_CH_6_ISR
        PwmHwConfiguration_28: PwmChannelIsUsed=0, PwmInterruptHwId=PWM_FTM_2_CH_7_ISR
        PwmHwConfiguration_29: PwmChannelIsUsed=0, PwmInterruptHwId=PWM_FTM_2_TOF_ISR
        PwmHwConfiguration_3: PwmChannelIsUsed=0, PwmInterruptHwId=PWM_FTM_0_CH_2_ISR
        PwmHwConfiguration_30: PwmChannelIsUsed=0, PwmInterruptHwId=PWM_FTM_2_FAULT_ISR
        PwmHwConfiguration_31: PwmChannelIsUsed=0, PwmInterruptHwId=PWM_FTM_3_CH_0_ISR
        PwmHwConfiguration_32: PwmChannelIsUsed=0, PwmInterruptHwId=PWM_FTM_3_CH_1_ISR
        PwmHwConfiguration_33: PwmChannelIsUsed=0, PwmInterruptHwId=PWM_FTM_3_CH_2_ISR
        PwmHwConfiguration_34: PwmChannelIsUsed=0, PwmInterruptHwId=PWM_FTM_3_CH_3_ISR
        PwmHwConfiguration_35: PwmChannelIsUsed=0, PwmInterruptHwId=PWM_FTM_3_CH_4_ISR
        PwmHwConfiguration_36: PwmChannelIsUsed=0, PwmInterruptHwId=PWM_FTM_3_CH_5_ISR
        PwmHwConfiguration_37: PwmChannelIsUsed=0, PwmInterruptHwId=PWM_FTM_3_CH_6_ISR
        PwmHwConfiguration_38: PwmChannelIsUsed=0, PwmInterruptHwId=PWM_FTM_3_CH_7_ISR
        PwmHwConfiguration_39: PwmChannelIsUsed=0, PwmInterruptHwId=PWM_FTM_3_TOF_ISR
        PwmHwConfiguration_4: PwmChannelIsUsed=0, PwmInterruptHwId=PWM_FTM_0_CH_3_ISR
        PwmHwConfiguration_40: PwmChannelIsUsed=0, PwmInterruptHwId=PWM_FTM_3_FAULT_ISR
        PwmHwConfiguration_5: PwmChannelIsUsed=0, PwmInterruptHwId=PWM_FTM_0_CH_4_ISR
        PwmHwConfiguration_6: PwmChannelIsUsed=0, PwmInterruptHwId=PWM_FTM_0_CH_5_ISR
        PwmHwConfiguration_7: PwmChannelIsUsed=0, PwmInterruptHwId=PWM_FTM_0_CH_6_ISR
        PwmHwConfiguration_8: PwmChannelIsUsed=0, PwmInterruptHwId=PWM_FTM_0_CH_7_ISR
        PwmHwConfiguration_9: PwmChannelIsUsed=0, PwmInterruptHwId=PWM_FTM_0_TOF_ISR
  module config Mcu: implementation-config-variant=VARIANT-PRE-COMPILE
    CommonPublishedInformation:
      ArReleaseMajorVersion = 4
      ArReleaseMinorVersion = 2
      ArReleaseRevisionVersion = 2
      ModuleId = 101
      SwMajorVersion = 1
      SwMinorVersion = 0
      SwPatchVersion = 2
      VendorApiInfix = 
      VendorId = 43
    McuDebugConfiguration:
      McuDisableCmuApi = 0
      McuDisableDemReportErrorStatus = 0
      McuEnablePeripheralCMU = 0
      McuGetMidrStructureApi = 0
      McuGetPeriphStateApi = 0
      McuSRAMRetentionConfigApi = 0
    McuGeneralConfiguration:
      McuCalloutBeforePerformReset = 0
      McuDevErrorDetect = 0
      McuDisablePmcInit = 0
      McuDisableRcmInit = 0
      McuDisableSimInit = 0
      McuDisableSmcInit = 0
      McuEnableUserModeSupport = 0
      McuEnterLowPowerMode = 1
      McuGetRamStateApi = 0
      McuInitClock = 1
      McuNoPll = 0
      McuPerformResetApi = 0
      McuPerformResetCallout = NULL_PTR
      McuTimeout = 50000
      McuVersionInfoApi = 0
    McuModuleConfiguration:
      McuClockSrcFailureNotification = DISABLED
      McuLPO1KClockEnable = 1
      McuLPO32KClockEnable = 1
      McuLPOClockSelect = LPO_CLK_128K
      McuNumberOfMcuModes = 3
      McuRTCCLKINFrequencyHz = 32000.0
      McuRamSectors = 1
      McuRtcClkSelect = LPO_CLK_32K
      McuAllowedModes: McuAllowHighSpeedRunMode=1, McuAllowVeryLowPowerModes=1
      McuClockSettingConfig_0 (McuClockSettingConfig): McuClockSettingId=0, McuScgClkOutSelect=FIRC, McuSysClockUnderMcuControl=1
        McuClkMonitor_0:
          McuClkMonitorEn = 0
          McuFrequencyHigherInterrupt = 0
          McuFrequencyLowerInterrupt = 0
          McuHighFrequencyRef = 16777215
          McuLowFrequencyRef = 0
          McuReferenceCountConfiguration = 65535
        McuClkMonitor_1:
          McuClkMonitorEn = 0
          McuFrequencyHigherInterrupt = 0
          McuFrequencyLowerInterrupt = 0
          McuHighFrequencyRef = 16777215
          McuLowFrequencyRef = 0
          McuReferenceCountConfiguration = 65535
        4 x McuClockReferencePoint:
          McuClockReferencePoint_LPIT0_CLK: McuClockFrequencySelect=LPIT_CLK, McuClockReferencePointFrequency=8000000.0
          McuClockReferencePoint_RUN_BUS_CLK: McuClockFrequencySelect=RUN_BUS_CLK, McuClockReferencePointFrequency=4.0E7
          McuClockReferencePoint_SIRC_CLK: McuClockFrequencySelect=SIRC_CLK, McuClockReferencePointFrequency=8000000.0
          McuClockReferencePoint_SYS_CLK: McuClockFrequencySelect=RUN_SYS_CLK, McuClockReferencePointFrequency=8.0E7
        McuFIRCClockConfig:
          McuFIRCDiv1 = 1
          McuFIRCDiv1Frequency = 4.8E7
          McuFIRCDiv2 = 2
          McuFIRCDiv2Frequency = 2.4E7
          McuFIRCEnable = 1
          McuFIRCFrequency = 4.8E7
          McuFIRCRangeSelect = TRIMMED_TO_48MHZ
          McuFIRCRegulatorEnable = 0
          McuFIRCUnderMcuControl = 1
        McuHsrunClockConfig:
          McuBusClockDivider = 2
          McuBusClockFrequency = 2000000.0
          McuCoreClockDivider = 2
          McuCoreClockFrequency = 4000000.0
          McuFlashClockFrequency = 1000000.0
          McuPreDivSystemClockFrequency = 8000000.0
          McuScgClkOutFrequency = 4.8E7
          McuSlowClockDivider = 4
          McuSystemClockFrequency = 4000000.0
          McuSystemClockSwitch = SOSC
        32 x McuPeripheralClockConfig, all with McuPeripheralClockDivider=1, McuPeripheralClockEnable=1, McuPeripheralFractionalDivider=0:
          McuPeripheralClockConfig_0: McuPerName=FTFC, McuPeripheralClockFrequency=0.0, McuPeripheralClockSelect=EXT_CLK_OR_CLK_OFF
          McuPeripheralClockConfig_1: McuPerName=DMAMUX0, McuPeripheralClockFrequency=0.0, McuPeripheralClockSelect=EXT_CLK_OR_CLK_OFF
          McuPeripheralClockConfig_10: McuPerName=PDB1, McuPeripheralClockFrequency=0.0, McuPeripheralClockSelect=EXT_CLK_OR_CLK_OFF
          McuPeripheralClockConfig_11: McuPerName=CRC, McuPeripheralClockFrequency=0.0, McuPeripheralClockSelect=EXT_CLK_OR_CLK_OFF
          McuPeripheralClockConfig_12: McuPerName=PDB0, McuPeripheralClockFrequency=0.0, McuPeripheralClockSelect=EXT_CLK_OR_CLK_OFF
          McuPeripheralClockConfig_13: McuPerName=LPIT, McuPeripheralClockFrequency=8000000.0, McuPeripheralClockSelect=SOSC
          McuPeripheralClockConfig_14: McuPerName=FTM0, McuPeripheralClockFrequency=8000000.0, McuPeripheralClockSelect=SOSC
          McuPeripheralClockConfig_15: McuPerName=FTM1, McuPeripheralClockFrequency=8000000.0, McuPeripheralClockSelect=SOSC
          McuPeripheralClockConfig_16: McuPerName=FTM2, McuPeripheralClockFrequency=8000000.0, McuPeripheralClockSelect=SOSC
          McuPeripheralClockConfig_17: McuPerName=ADC0, McuPeripheralClockFrequency=0.0, McuPeripheralClockSelect=EXT_CLK_OR_CLK_OFF
          McuPeripheralClockConfig_18: McuPerName=RTC, McuPeripheralClockFrequency=0.0, McuPeripheralClockSelect=EXT_CLK_OR_CLK_OFF
          McuPeripheralClockConfig_19: McuPerName=LPTMR0, McuPeripheralClockFrequency=0.0, McuPeripheralClockSelect=EXT_CLK_OR_CLK_OFF
          McuPeripheralClockConfig_2: McuPerName=FLEXCAN0, McuPeripheralClockFrequency=0.0, McuPeripheralClockSelect=EXT_CLK_OR_CLK_OFF
          McuPeripheralClockConfig_20: McuPerName=PORTA, McuPeripheralClockFrequency=0.0, McuPeripheralClockSelect=EXT_CLK_OR_CLK_OFF
          McuPeripheralClockConfig_21: McuPerName=PORTB, McuPeripheralClockFrequency=0.0, McuPeripheralClockSelect=EXT_CLK_OR_CLK_OFF
          McuPeripheralClockConfig_22: McuPerName=PORTC, McuPeripheralClockFrequency=0.0, McuPeripheralClockSelect=EXT_CLK_OR_CLK_OFF
          McuPeripheralClockConfig_23: McuPerName=PORTD, McuPeripheralClockFrequency=0.0, McuPeripheralClockSelect=EXT_CLK_OR_CLK_OFF
          McuPeripheralClockConfig_24: McuPerName=PORTE, McuPeripheralClockFrequency=0.0, McuPeripheralClockSelect=EXT_CLK_OR_CLK_OFF
          McuPeripheralClockConfig_25: McuPerName=FLEXIO, McuPeripheralClockFrequency=0.0, McuPeripheralClockSelect=EXT_CLK_OR_CLK_OFF
          McuPeripheralClockConfig_26: McuPerName=EWM, McuPeripheralClockFrequency=0.0, McuPeripheralClockSelect=EXT_CLK_OR_CLK_OFF
          McuPeripheralClockConfig_27: McuPerName=LPI2C0, McuPeripheralClockFrequency=0.0, McuPeripheralClockSelect=EXT_CLK_OR_CLK_OFF
          McuPeripheralClockConfig_28: McuPerName=LPUART0, McuPeripheralClockFrequency=0.0, McuPeripheralClockSelect=EXT_CLK_OR_CLK_OFF
          McuPeripheralClockConfig_29: McuPerName=LPUART1, McuPeripheralClockFrequency=0.0, McuPeripheralClockSelect=EXT_CLK_OR_CLK_OFF
          McuPeripheralClockConfig_3: McuPerName=FLEXCAN1, McuPeripheralClockFrequency=0.0, McuPeripheralClockSelect=EXT_CLK_OR_CLK_OFF
          McuPeripheralClockConfig_30: McuPerName=LPUART2, McuPeripheralClockFrequency=0.0, McuPeripheralClockSelect=EXT_CLK_OR_CLK_OFF
          McuPeripheralClockConfig_31: McuPerName=CMP0, McuPeripheralClockFrequency=0.0, McuPeripheralClockSelect=EXT_CLK_OR_CLK_OFF
          McuPeripheralClockConfig_4: McuPerName=FTM3, McuPeripheralClockFrequency=0.0, McuPeripheralClockSelect=EXT_CLK_OR_CLK_OFF
          McuPeripheralClockConfig_5: McuPerName=ADC1, McuPeripheralClockFrequency=8000000.0, McuPeripheralClockSelect=SOSC
          McuPeripheralClockConfig_6: McuPerName=FLEXCAN2, McuPeripheralClockFrequency=0.0, McuPeripheralClockSelect=EXT_CLK_OR_CLK_OFF
          McuPeripheralClockConfig_7: McuPerName=LPSPI0, McuPeripheralClockFrequency=0.0, McuPeripheralClockSelect=EXT_CLK_OR_CLK_OFF
          McuPeripheralClockConfig_8: McuPerName=LPSPI1, McuPeripheralClockFrequency=0.0, McuPeripheralClockSelect=EXT_CLK_OR_CLK_OFF
          McuPeripheralClockConfig_9: McuPerName=LPSPI2, McuPeripheralClockFrequency=0.0, McuPeripheralClockSelect=EXT_CLK_OR_CLK_OFF
        McuRunClockConfig:
          McuBusClockDivider = 2
          McuBusClockFrequency = 4.0E7
          McuCoreClockDivider = 2
          McuCoreClockFrequency = 8.0E7
          McuFlashClockFrequency = 2.6666666E7
          McuPreDivSystemClockFrequency = 1.6E8
          McuScgClkOutFrequency = 4.8E7
          McuSlowClockDivider = 3
          McuSystemClockFrequency = 8.0E7
          McuSystemClockSwitch = SPLL
        McuSIMClockConfig:
          McuClockOutDivider = 1
          McuClockOutEnable = 1
          McuClockOutSelect = SCG_CLKOUT
          McuDMAClockGatingEnable = 1
          McuDebugTraceDividerEnable = 1
          McuEIMClockGatingEnable = 1
          McuERMClockGatingEnable = 1
          McuGPIOClockGatingEnable = 0
          McuMPUClockGatingEnable = 1
          McuMSCMClockGatingEnable = 1
          McuTraceClockDivider = 1
          McuTraceClockFraction = 0
          McuTraceClockSelect = CORE_CLK
        McuSIRCClockConfig:
          McuSIRCDiv1 = 1
          McuSIRCDiv1Frequency = 8000000.0
          McuSIRCDiv2 = 2
          McuSIRCDiv2Frequency = 4000000.0
          McuSIRCEnable = 1
          McuSIRCFrequency = 8000000.0
          McuSIRCLowPowerEnable = 0
          McuSIRCRangeSelect = HIGH_RANGE_CLOCK
          McuSIRCStopEnable = 0
          McuSIRCUnderMcuControl = 1
        McuSystemOSCClockConfig:
          McuSOSCClockMonitorEnable = 0
          McuSOSCClockMonitorResetEnable = 0
          McuSOSCDiv1 = 1
          McuSOSCDiv1Frequency = 8000000.0
          McuSOSCDiv2 = 1
          McuSOSCDiv2Frequency = 8000000.0
          McuSOSCEnable = 1
          McuSOSCExternalReferenceSelect = 0
          McuSOSCFrequency = 8000000.0
          McuSOSCHighGainOscillatorSelect = 0
          McuSOSCRangeSelect = MEDIUM_FREQ_RANGE
          McuSOSCUnderMcuControl = 1
        McuSystemPll:
          McuSPLLClockMonitorEnable = 0
          McuSPLLClockMonitorResetEnable = 0
          McuSPLLDiv1 = 2
          McuSPLLDiv1Frequency = 8.0E7
          McuSPLLDiv2 = 4
          McuSPLLDiv2Frequency = 4.0E7
          McuSPLLEnable = 1
          McuSPLLFrequency = 1.6E8
          McuSPLLInputClkPreDivider = 1
          McuSPLLInputFrequency = 8000000.0
          McuSPLLMultiplier = 40
          McuSystemPllUnderMcuControl = 1
        McuVlprClockConfig:
          McuBusClockDivider = 1
          McuBusClockFrequency = 4000000.0
          McuCoreClockDivider = 2
          McuCoreClockFrequency = 4000000.0
          McuFlashClockFrequency = 1000000.0
          McuPreDivSystemClockFrequency = 8000000.0
          McuScgClkOutFrequency = 4.8E7
          McuSlowClockDivider = 4
          McuSystemClockFrequency = 4000000.0
          McuSystemClockSwitch = SIRC
      McuInterruptEvents: McuAlternateResetEvent=0, McuVoltageErrorEvent=0
      3 x McuModeSettingConf:
        McuModeSettingConf_HSRun: McuMode=1, McuPowerMode=HSRUN
        McuModeSettingConf_Run: McuMode=0, McuPowerMode=RUN
        McuModeSettingConf_Sleep: McuMode=2, McuPowerMode=STOP1
      McuPowerControl:
        McuClockBiasDisable = 0
        McuLPODisable = 0
        McuLowPowerBiasEnable = 0
        McuLowVoltageDetectInterruptEnable = 0
        McuLowVoltageDetectResetEnable = 0
        McuLowVoltageWarningInterruptEnable = 0
        McuLpoTrimming = 0
      McuRamSectorSettingConf_0 (McuRamSectorSettingConf):
        McuRamDefaultValue = 0
        McuRamSectionBaseAddrLinkerSym = 
        McuRamSectionBaseAddress = 536869888
        McuRamSectionSize = 1024
        McuRamSectionSizeLinkerSym = 
        McuRamSectorId = 0
      McuResetConfig: McuResetPinFilterBusClockSelect=0, McuResetPinFilterInRunAndWait=ALL_FILTERING_DISABLE, McuResetPinFilterInStopMode=ALL_FILTERING_DISABLE
        McuSystemInterruptEnable:
          McuCMULossOfClockResetInterrupt = 0
          McuCoreLockupInterrupt = 0
          McuExternalResetPinInterrupt = 0
          McuGlobalInterrupt = 0
          McuJTAGResetInterrupt = 0
          McuLossOfClockInterrupt = 0
          McuLossOfLockInterrupt = 0
          McuMDMAPSystemResetInterrupt = 0
          McuResetDelayTime = DELAY_10_LPO_CYCLES
          McuSoftwareInterrupt = 0
          McuStopAcknowledgeErrorInterrupt = 0
          McuWatchdogInterrupt = 0
      McuSIMConfig
        McuAdcOptionsConfiguration:
          McuADC0PreTrigeerSourceSelect = PDB_PRE_TRIGGER
          McuADC0SoftwarePreTrigeerSourceSelect = SW_PRE_TRIGGER_DISABLE
          McuADC0TrigeerSourceSelect = PDB
          McuADC1PreTrigeerSourceSelect = PDB_PRE_TRIGGER
          McuADC1SoftwarePreTrigeerSourceSelect = SW_PRE_TRIGGER_DISABLE
          McuADC1TrigeerSourceSelect = PDB
          McuSoftwareTriggerToTRGMUX = 0
        McuChipControlConfiguration:
          McuAdcSupply = VDD
          McuEnableAdcSupplyMonitoring = 0
          McuPDBBackToBackSelect = 0
          McuPTB0InterleaveChannelSelect = 0
          McuPTB13InterleaveChannelSelect = 0
          McuPTB14InterleaveChannelSelect = 0
          McuPTB1InterleaveChannelSelect = 0
        McuFlexTimerConfiguration:
          McuFTM0Ch{0..7}ModulationSelect = 0
          McuFTM0ExternalClockPinSelect = TCLK0_PIN
          McuFTM0Fault{0..2}Select = FTM0_FLT{0..2}_PIN
          McuFTM0OBEControl = 0
          McuFTM0SyncBit = 0
          McuFTM1Ch0InputSelect = FTM1_CH0_INPUT
          McuFTM1ExternalClockPinSelect = TCLK0_PIN
          McuFTM1Fault{0..2}Select = FTM1_FLT{0..2}_PIN
          McuFTM1OBEControl = 0
          McuFTM1SyncBit = 0
          McuFTM2Ch0InputSelect = FTM2_CH0_INPUT
          McuFTM2Ch1InputSelect = FTM2_CHI1_INPUT
          McuFTM2ExternalClockPinSelect = TCLK0_PIN
          McuFTM2Fault{0..2}Select = FTM2_FLT{0..2}_PIN
          McuFTM2OBEControl = 0
          McuFTM2SyncBit = 0
          McuFTM3Ch{0..7}ModulationSelect = 0
          McuFTM3ExternalClockPinSelect = TCLK0_PIN
          McuFTM3Fault{0..2}Select = FTM3_FLT{0..2}_PIN
          McuFTM3OBEControl = 0
          McuFTM3SyncBit = 0
          McuFTM4ExternalClockPinSelect = TCLK0_PIN
          McuFTM4OBEControl = 0
          McuFTM4SyncBit = 0
          McuFTM5ExternalClockPinSelect = TCLK0_PIN
          McuFTM5OBEControl = 0
          McuFTM5SyncBit = 0
          McuFTM6ExternalClockPinSelect = TCLK0_PIN
          McuFTM6OBEControl = 0
          McuFTM6SyncBit = 0
          McuFTM7ExternalClockPinSelect = TCLK0_PIN
          McuFTM7OBEControl = 0
          McuFTM7SyncBit = 0
          McuFTMGlobalLoadEnable = 0
          McuFTM_GTBControl = 0
          McuQspiClkSelect = 0
          McuRMII_ClkSelect = 0
          McuRMII_Clk_OBE = 0
    McuPublishedInformation
      15 x McuResetReasonConf:
        MCU_CMU_LOC_RESET: McuResetReason=14
        MCU_CORE_LOCKUP_RESET: McuResetReason=3
        MCU_EXTERNAL_PIN_RESET: McuResetReason=6
        MCU_JTAG_RESET: McuResetReason=4
        MCU_LOSS_OF_CLOCK_RESET: McuResetReason=9
        MCU_LOSS_OF_LOCK_RESET: McuResetReason=8
        MCU_LOW_OR_HIGH_VOLTAGE_DETECT_RESET: McuResetReason=10
        MCU_MDM_AP_SYSTEM_RESET: McuResetReason=1
        MCU_MULTIPLE_RESET_REASON: McuResetReason=12
        MCU_NO_RESET_REASON: McuResetReason=11
        MCU_POWER_ON_RESET: McuResetReason=5
        MCU_RESET_UNDEFINED: McuResetReason=13
        MCU_STOP_ACKNOWLEDGE_ERROR_RESET: McuResetReason=0
        MCU_SW_RESET: McuResetReason=2
        MCU_WATCHDOG_RESET: McuResetReason=7
  module config Mcl: implementation-config-variant=VARIANT-PRE-COMPILE
    CommonPublishedInformation:
      ArReleaseMajorVersion = 4
      ArReleaseMinorVersion = 2
      ArReleaseRevisionVersion = 2
      ModuleId = 255
      SwMajorVersion = 1
      SwMinorVersion = 0
      SwPatchVersion = 2
      VendorId = 43
    MclConfigSet_0 (MclConfigSet)
      DMAChannel_0 (DMAChannel):
        DMAChannelPriority = 0
        DPA = 0
        DmaHwChannel = eDMA_0
        DmaSource{0..9} = NOT_USED
        ECP = 0
        EMI = 0
        MclDMAChannelEnable = 0
        MclDMAChannelId = 0
        MclDMAChannelTriggerEnable = 0
        MclDmaTransferCompletionNotif = NULL_PTR
      DmaInstance_0 (DmaInstance): DmaHwInstance=eDMA_Instance0, MclEDMA_CLM=0, MclEDMA_CX=0, MclEDMA_ECX=0, MclEDMA_EDBG=0, MclEDMA_ERCA=0, MclEDMA_HALT=0, MclEDMA_HOE=0
      FlexioConfig
        FlexioGeneral: DBGE=0, DozenEnable=0
      TriggerMux:
        TrgMuxAdc0Input{0..3} = INPUT_DISABLED
        TrgMuxAdc0LockEn = 0
        TrgMuxAdc1Input{0..3} = INPUT_DISABLED
        TrgMuxAdc1LockEn = 0
        TrgMuxCmp0Input0 = INPUT_DISABLED
        TrgMuxCmp0LockEn = 0
        TrgMuxDmaMux0Input{0..3} = INPUT_DISABLED
        TrgMuxDmaMux0LockEn = 0
        TrgMuxFlexIoInput{0..3} = INPUT_DISABLED
        TrgMuxFlexIoLockEn = 0
        TrgMuxFtm0Input{0..3} = INPUT_DISABLED
        TrgMuxFtm0LockEn = 0
        TrgMuxFtm1Input{0..3} = INPUT_DISABLED
        TrgMuxFtm1LockEn = 0
        TrgMuxFtm2Input{0..3} = INPUT_DISABLED
        TrgMuxFtm2LockEn = 0
        TrgMuxFtm3Input{0..3} = INPUT_DISABLED
        TrgMuxFtm3LockEn = 0
        TrgMuxFtm4Input0 = INPUT_DISABLED
        TrgMuxFtm4LockEn = 0
        TrgMuxFtm5Input0 = INPUT_DISABLED
        TrgMuxFtm5LockEn = 0
        TrgMuxFtm6Input0 = INPUT_DISABLED
        TrgMuxFtm6LockEn = 0
        TrgMuxFtm7Input0 = INPUT_DISABLED
        TrgMuxFtm7LockEn = 0
        TrgMuxLpi2c0Input0 = INPUT_DISABLED
        TrgMuxLpi2c0LockEn = 0
        TrgMuxLpi2c1Input0 = INPUT_DISABLED
        TrgMuxLpi2c1LockEn = 0
        TrgMuxLpitInput{0..3} = INPUT_DISABLED
        TrgMuxLpitLockEn = 0
        TrgMuxLpspi0Input0 = INPUT_DISABLED
        TrgMuxLpspi0LockEn = 0
        TrgMuxLpspi1Input0 = INPUT_DISABLED
        TrgMuxLpspi1LockEn = 0
        TrgMuxLptmr0Input0 = INPUT_DISABLED
        TrgMuxLptmr0LockEn = 0
        TrgMuxLpuart0Input0 = INPUT_DISABLED
        TrgMuxLpuart0LockEn = 0
        TrgMuxLpuart1Input0 = INPUT_DISABLED
        TrgMuxLpuart1LockEn = 0
        TrgMuxPdb0Input0 = INPUT_DISABLED
        TrgMuxPdb0LockEn = 0
        TrgMuxPdb1Input0 = INPUT_DISABLED
        TrgMuxPdb1LockEn = 0
        TrgMuxXOut0Input{0..3} = INPUT_DISABLED
        TrgMuxXOut0LockEn = 0
        TrgMuxXOut1Input{0..3} = INPUT_DISABLED
        TrgMuxXOut1LockEn = 0
    MclGeneral:
      EnableDMA = 1
      EnableFlexioSupport = 0
      MclDevErrorDetect = 0
      MclDisableDemReportErrorStatus = 0
      MclDmaNotificationSupported = 1
      MclEnableTrgMux = 0
      MclEnableUserModeSupport = 0
      MclErrorChecking = 0
      MclErrorNotificationDma0 = NULL_PTR
      Mcl_CommonTimebaseSupported = 0
      Mcl_DeInitApi = 0
      Mcl_DmaGetChannelErrorStatusApi = 0
      Mcl_DmaGetGlobalErrorStatusApi = 0
      Mcl_VersionInfoApi = 1
      16 x MclIsrAvailable, all with MclIsrEnabled=1:
        MclIsrAvailable_0: MclIsrName=eDMA_0
        MclIsrAvailable_1: MclIsrName=eDMA_1
        MclIsrAvailable_{10..15}: MclIsrName=eDMA_{10..15}
        MclIsrAvailable_{2..9}: MclIsrName=eDMA_{2..9}
      MclLmem: MclLmemCacheTimeout=2147483647, MclLmemEnableCacheApi=0, MclLmemEnableWriteBuffer=0, MclSynchronizeCache=0
  module config Resource: implementation-config-variant=VARIANT-PRE-COMPILE
    CommonPublishedInformation:
      ArReleaseMajorVersion = 4
      ArReleaseMinorVersion = 2
      ArReleaseRevisionVersion = 2
      ModuleId = 0
      SwMajorVersion = 1
      SwMinorVersion = 0
      SwPatchVersion = 2
      VendorId = 43
    ResourceGeneral: ResourceSubderivative=s32k144_lqfp100
  module config Base: implementation-config-variant=VARIANT-PRE-COMPILE
    CommonPublishedInformation:
      ArReleaseMajorVersion = 4
      ArReleaseMinorVersion = 2
      ArReleaseRevisionVersion = 2
      ModuleId = 0
      SwMajorVersion = 1
      SwMinorVersion = 0
      SwPatchVersion = 2
      VendorId = 43
  module config Port: implementation-config-variant=VARIANT-PRE-COMPILE
    CommonPublishedInformation:
      ArReleaseMajorVersion = 4
      ArReleaseMinorVersion = 2
      ArReleaseRevisionVersion = 2
      ModuleId = 124
      SwMajorVersion = 1
      SwMinorVersion = 0
      SwPatchVersion = 2
      VendorId = 43
    PortConfigSet_0 (PortConfigSet)
      NotUsedPortPin:
        PortPinDSE = Low_Drive_Strength
        PortPinDirection = PORT_PIN_IN
        PortPinLevelValue = PORT_PIN_LEVEL_LOW
        PortPinMode = GPIO
        PortPinPE = PullDisabled
        PortPinPS = PullDown
      PortContainer_0 (PortContainer): PortNumberOfPortPins=10
        10 x PortPin, all with PortPinInitialMode=PORT_GPIO_MODE, PortPinPE=PullDisabled, PortPinPFE=0, PortPinPS=PullDown:
          PortPin_ADC0_SE12: PortPinDSE=High_drive_strength, PortPinDirection=PORT_PIN_IN, PortPinDirectionChangeable=1, PortPinId=8, PortPinLevelValue=PORT_PIN_LEVEL_LOW, PortPinMode=ADC0_SE12, PortPinModeChangeable=1, PortPinPcr=78
          PortPin_Can_Rx: PortPinDSE=Low_drive_strength, PortPinDirection=PORT_PIN_IN, PortPinDirectionChangeable=1, PortPinId=9, PortPinLevelValue=PORT_PIN_LEVEL_LOW, PortPinMode=CAN0_RX, PortPinModeChangeable=1, PortPinPcr=132
          PortPin_Can_Tx: PortPinDSE=Low_drive_strength, PortPinDirection=PORT_PIN_OUT, PortPinDirectionChangeable=1, PortPinId=10, PortPinLevelValue=PORT_PIN_LEVEL_LOW, PortPinMode=CAN0_TX, PortPinModeChangeable=1, PortPinPcr=133
          PortPin_EXTAL: PortPinDSE=Low_drive_strength, PortPinDirection=PORT_PIN_IN, PortPinDirectionChangeable=1, PortPinId=6, PortPinLevelValue=PORT_PIN_LEVEL_LOW, PortPinMode=EXTAL, PortPinModeChangeable=0, PortPinPcr=39
          PortPin_EXT_CLOCK: PortPinDSE=Low_drive_strength, PortPinDirection=PORT_PIN_OUT, PortPinDirectionChangeable=1, PortPinId=7, PortPinLevelValue=PORT_PIN_LEVEL_LOW, PortPinMode=CLKOUT, PortPinModeChangeable=1, PortPinPcr=138
          PortPin_Key1: PortPinDSE=Low_drive_strength, PortPinDirection=PORT_PIN_IN, PortPinDirectionChangeable=0, PortPinId=4, PortPinLevelValue=PORT_PIN_LEVEL_LOW, PortPinMode=GPIO, PortPinModeChangeable=0, PortPinPcr=76
          PortPin_LedBlue: PortPinDSE=High_drive_strength, PortPinDirection=PORT_PIN_OUT, PortPinDirectionChangeable=0, PortPinId=1, PortPinLevelValue=PORT_PIN_LEVEL_HIGH, PortPinMode=GPIO, PortPinModeChangeable=0, PortPinPcr=96
          PortPin_LedGreen: PortPinDSE=Low_drive_strength, PortPinDirection=PORT_PIN_OUT, PortPinDirectionChangeable=1, PortPinId=3, PortPinLevelValue=PORT_PIN_LEVEL_LOW, PortPinMode=GPIO, PortPinModeChangeable=1, PortPinPcr=112
          PortPin_LedRed: PortPinDSE=Low_drive_strength, PortPinDirection=PORT_PIN_OUT, PortPinDirectionChangeable=1, PortPinId=2, PortPinLevelValue=PORT_PIN_LEVEL_HIGH, PortPinMode=FTM0_CH0, PortPinModeChangeable=1, PortPinPcr=111
          PortPin_XTAL: PortPinDSE=High_drive_strength, PortPinDirection=PORT_PIN_OUT, PortPinDirectionChangeable=1, PortPinId=5, PortPinLevelValue=PORT_PIN_LEVEL_LOW, PortPinMode=XTAL, PortPinModeChangeable=0, PortPinPcr=38
    PortGeneral:
      PortDevErrorDetect = 1
      PortEnableUserModeSupport = 0
      PortSet2PinsDirectionApi = 0
      PortSetPinDirectionApi = 1
      PortSetPinModeApi = 1
      PortSetPinModeDoesNotTouchGpioLevel = 0
      PortVersionInfoApi = 1
  module config Adc: implementation-config-variant=VARIANT-PRE-COMPILE
    AdcConfigSet
      AdcHwUnit_0 (AdcHwUnit):
        AdcHwUnitId = ADC0
        AdcLogicalUnitId = 0
        AdcOffsetCorrectionValue = 0
        AdcResolution = BITS_12
        AdcTransferType = ADC_INTERRUPT
        AdcVoltageReferenceSelection = VREFH_VREFL
        AdcPotChannel (AdcChannel): AdcChannelId=AN_12, AdcLogicalChannelId=0
        AdcGroup_0 (AdcGroup):
          AdcDelayNextPdb = 0
          AdcEnableDoubleBuffering = 0
          AdcEnableHalfInterrupt = 0
          AdcExtraNotification = NULL_PTR
          AdcGroupAccessMode = ADC_ACCESS_MODE_SINGLE
          AdcGroupConversionMode = ADC_CONV_MODE_ONESHOT
          AdcGroupConversionType = ADC_CONV_TYPE_NORMAL
          AdcGroupId = 0
          AdcGroupInBacktoBackMode = 1
          AdcGroupTriggSrc = ADC_TRIGG_SRC_SW
          AdcGroupUsesChannelDelays = 0
          AdcPdbPeriodContinuousMode = 0
          AdcStreamingBufferMode = ADC_STREAM_BUFFER_LINEAR
          AdcStreamingNumSamples = 1
          AdcWithoutInterrupts = 0
          AdcGroupDefinition = AdcPotChannel
          AdcGroupNormalConversionTimings: AdcGroupClockDivideSelect=DIV_2, AdcGroupHardwareAverageEnable=0, AdcGroupHardwareAverageSelect=SAMPLES_4, AdcGroupSampleTimeDuration=2
        AdcNormalConversionTimings: AdcClockDivideSelect=DIV_NONE, AdcHardwareAverageEnable=0, AdcHardwareAverageSelect=SAMPLES_4, AdcSampleTimeDuration=2
        AdcPdbSettings: AdcPdbChannelSequenceErrorEnable=0, AdcPdbErrorNotification=NULL_PTR, AdcPdbMultiplicationFactorSelect=0, AdcPdbPrescalerDividerSelect=0
    AdcGeneral:
      AdcDeInitApi = 1
      AdcDevErrorDetect = 0
      AdcDmaTimeout = 65535
      AdcEnableLimitCheck = 0
      AdcEnableQueuing = 1
      AdcEnableStartStopGroupApi = 1
      AdcGrpNotifCapability = 1
      AdcHwTriggerApi = 0
      AdcPriorityImplementation = ADC_PRIORITY_NONE
      AdcPriorityQueueMaxDepth = 1
      AdcReadGroupApi = 1
      AdcResultAlignment = ADC_ALIGN_RIGHT
      AdcTimeout = 65535
      AdcVersionInfoApi = 1
    AdcInterrupt_0 (AdcInterrupt): AdcInterruptEnable=1, AdcInterruptSource=ADC0_COCO
    AdcInterrupt_1 (AdcInterrupt): AdcInterruptEnable=0, AdcInterruptSource=ADC1_COCO
    AdcPublishedInformation: AdcChannelValueSigned=0, AdcGroupFirstChannelFixed=0, AdcMaxChannelResolution=12
    CommonPublishedInformation:
      ArReleaseMajorVersion = 4
      ArReleaseMinorVersion = 2
      ArReleaseRevisionVersion = 2
      ModuleId = 123
      SwMajorVersion = 1
      SwMinorVersion = 0
      SwPatchVersion = 2
      VendorApiInfix = 
      VendorId = 43
    NonAutosar:
      AdcBypassConsistencyLoop = 0
      AdcContinuousWithoutInterrupt = 0
      AdcConvTimeOnce = 0
      AdcDisableDemReportErrorStatus = 0
      AdcEnableCalibration = 0
      AdcEnableDmaTrasferMode = 0
      AdcEnableDoubleBufferingOptimization = 0
      AdcEnableDualClockMode = 0
      AdcEnableGroupDependentChannelNames = 0
      AdcEnableInitialNotification = 0
      AdcEnableSetChannel = 0
      AdcEnableUserModeSupport = 0
      AdcOptimizeOneShotHwTriggerConversions = 0
      AdcUseHardwareNormalGroups = 0
  module config Os: implementation-config-variant=VARIANT-PRE-COMPILE, module-description=Os
    OsAppMode
    OsOS:
      OsScalabilityClass = SC1
      OsStackMonitoring = true
      OsStatus = EXTENDED
      OsUseGetServiceId = true
      OsUseParameterAccess = true
      OsUseResScheduler = true
      ArcOsTickFrequency = 1000
      ArcOsInterruptStackSize = 2048
      ArcOsIdleStackSize = 512
      ArcOsMaxIsr = 10
      OsHooks: OsErrorHook=false, OsPostTaskHook=false, OsPreTaskHook=false, OsShutdownHook=false, OsStartupHook=false
      ArcOsDebug: OsTaskDebug=false, OsAlarmDebug=false, OsResourceDebug=false, OsScheduleTableDebug=false, OsEventDebug=false, OsDebugActivated=false
    OsRteCounter (OsCounter): OsCounterMaxAllowedValue=65535, OsCounterMinCycle=1, OsCounterTicksPerBase=, OsCounterType=OS_TICK
    OsRteEvent (OsEvent): OsEventMask=1
    OsRteTask (OsTask): OsTaskActivation=1, OsTaskPriority=2, OsTaskSchedule=FULL, ArcOsTaskStackSize=2048, OsTaskEventRef=OsRteEvent
      OsTaskAutostart: OsTaskAppModeRef=(unset)
    OsRteAlarm10ms (OsAlarm): OsAlarmCounterRef=OsRteCounter
      OsAlarmAction
        OsAlarmSetEvent: OsAlarmSetEventRef=OsRteEvent, OsAlarmSetEventTaskRef=OsRteTask
      OsAlarmAutostart: OsAlarmAlarmTime=10, OsAlarmAutostartType=RELATIVE, OsAlarmCycleTime=10, OsAlarmAppModeRef=(unset)
    OsApplication:
      OsTrusted = true
      OsAppAlarmRef = OsRteAlarm10ms
      OsAppCounterRef = OsRteCounter
      OsAppTaskRef = OsRteTask
      OsAppTaskRef = OsStartupTask
      OsAppTaskRef = OsBswServiceTask
      OsAppAlarmRef = OsBswServiceAlarm
      OsApplicationHooks: OsAppErrorHook=false, OsAppShutdownHook=false, OsAppStartupHook=false
    OsStartupTask (OsTask): OsTaskActivation=1, OsTaskPriority=1, OsTaskSchedule=FULL, ArcOsTaskStackSize=2048
      OsTaskAutostart: OsTaskAppModeRef=(unset)
    OsBswServiceTask (OsTask): OsTaskActivation=1, OsTaskPriority=2, OsTaskSchedule=FULL, ArcOsTaskStackSize=2048, OsTaskAccessingApplication=OsApplication
    OsBswServiceAlarm (OsAlarm): OsAlarmCounterRef=OsRteCounter
      OsAlarmAction
        OsAlarmActivateTask: OsAlarmActivateTaskRef=OsBswServiceTask
      OsAlarmAutostart: OsAlarmAlarmTime=5, OsAlarmAutostartType=RELATIVE, OsAlarmCycleTime=5, OsAlarmAppModeRef=(unset)
  module config EcuM: implementation-config-variant=VARIANT-PRE-COMPILE, module-description=EcuM
    EcuMConfiguration
      EcuMCommonConfiguration: EcuMConfigConsistencyHash=, EcuMDefaultAppMode=(unset), EcuMOSResource=(unset)
        EcuMDefaultShutdownTarget: EcuMDefaultState=EcuMStateOff
        EcuMSleepMode: EcuMSleepModeId=, EcuMSleepModeSuspend=, EcuMSleepModeMcuModeRef=McuModeSettingConf_Sleep, EcuMWakeupSourceMask=EcuMWakeupSource
        EcuMWakeupSource: EcuMWakeupSourceId=, EcuMWakeupSourcePolling=false, EcuMResetReasonRef=(unset)
      EcuMFixedConfiguration: EcuMNvramReadallTimeout=10.0, EcuMNvramWriteallTimeout=10.0, EcuMRunMinimumDuration=10.0, EcuMNormalMcuModeRef=McuModeSettingConf_Run
        EcuMFixedUserConfig: EcuMFixedUser=
    EcuMGeneral: EcuMDevErrorDetect=false, EcuMIncludeDem=false, EcuMIncludeDet=false, EcuMMainFunctionPeriod=0.2, EcuMVersionInfoApi=false
    EcuMFixedGeneral: EcuMIncludeComM=, EcuMIncludeNvM=, EcuMIncludeNvramMgr=, EcuMTTIIEnabled=, EcuMTTIIWakeupSourceRef=(unset)
  module config Det: implementation-config-variant=VARIANT-PRE-COMPILE, module-description=Det
    DetGeneral:
      DetVersionInfoApi = false
      DetUseRamlog = true
      DetEnableCallbacks = false
      DetWrapRamlog = true
      DetUseStdErr = false
      DetDeInitAPI = false
      DetNumberOfCallbacks = 5
      DetRamlogSize = 16
      DetUseSafetyMonitor = false
  module config Rte: implementation-config-variant=VARIANT-PRE-COMPILE, module-description=Rte
    RteBswGeneral: RteSchMVersionInfoApi=, RteUseComShadowSignalApi=false
    RteGeneration:
      RteCalibrationSupport = NONE
      RteCodeVendorId = 
      RteDevErrorDetect = false
      RteDevErrorDetectUninit = false
      RteGenerationMode = COMPATIBILITY_MODE
      RteIocInteractionReturnValue = RTE_IOC
      RteMeasurementSupport = false
      RteOptimizationMode = RUNTIME
      RteValueRangeCheckEnabled = false
      RteVfbTraceEnabled = false
    RteInitializationBehavior: RteInitializationStrategy=, RteSectionInitializationPolicy=
    RteOsInteraction
    RtePostBuildVariantConfiguration: RtePostBuildUsedPredefinedVariant=(unset)
    5 x RteSwComponentInstance:
      IoHwAbInstance: RteSoftwareComponentInstanceRef=IoHwAbInstance
        6 x RteEventToTaskMapping, all with RteImmediateRestart=false, RteMappedToTaskRef=OsBswServiceTask:
          AnalogRead_Analog_Sensor_Read_OsBswServiceTask: RteEventRef=AnalogRead_Analog_Sensor_Read, RteUsedOsEventRef=(unset)
          DigitalRead_Digital_SwtCCW_Read_OsBswServiceTask: RteEventRef=DigitalRead_Digital_SwtCCW_Read
          DigitalRead_Digital_SwtCW_Read_OsBswServiceTask: RteEventRef=DigitalRead_Digital_SwtCW_Read
          DigitalWrite_Digital_RelayA_Write_OsBswServiceTask: RteEventRef=DigitalWrite_Digital_RelayA_Write
          DigitalWrite_Digital_RelayB_Write_OsBswServiceTask: RteEventRef=DigitalWrite_Digital_RelayB_Write
          PwmSetDuty_Pwm_RedLEDDuty_Set_OsBswServiceTask: RteEventRef=PwmSetDuty_Pwm_RedLEDDuty_Set
      MotorControlManagerInstance: RteSoftwareComponentInstanceRef=MotorControlManagerInstance
        MotorDirRunnableEvent_OsRteTask (RteEventToTaskMapping): RteImmediateRestart=false, RteEventRef=MotorDirRunnableEvent, RteMappedToTaskRef=OsRteTask, RteUsedOsEventRef=OsRteEvent
        MotorOutputRunnableEvent_OsRteTask (RteEventToTaskMapping): RteImmediateRestart=false, RteEventRef=MotorOutputRunnableEvent, RteMappedToTaskRef=OsRteTask, RteUsedOsEventRef=OsRteEvent
      PositionSensorInstance: RteSoftwareComponentInstanceRef=PositionSensorInstance
        PositionSensorMainEvent_OsRteTask (RteEventToTaskMapping): RteImmediateRestart=false, RteEventRef=PositionSensorMainEvent, RteMappedToTaskRef=OsRteTask, RteUsedOsEventRef=OsRteEvent
      RelayActuatorInstance: RteSoftwareComponentInstanceRef=RelayActuatorInstance
        RelayActuatorMainEvent_OsRteTask (RteEventToTaskMapping): RteImmediateRestart=false, RteEventRef=RelayActuatorMainEvent, RteMappedToTaskRef=OsRteTask, RteUsedOsEventRef=OsRteEvent
      SwitchInputInstance: RteSoftwareComponentInstanceRef=SwitchInputInstance
        SwitchInputMainEvent_OsRteTask (RteEventToTaskMapping): RteImmediateRestart=false, RteEventRef=SwitchInputMainEvent, RteMappedToTaskRef=OsRteTask, RteUsedOsEventRef=OsRteEvent
  module config Dio: implementation-config-variant=VARIANT-PRE-COMPILE
    CommonPublishedInformation:
      ArReleaseMajorVersion = 4
      ArReleaseMinorVersion = 2
      ArReleaseRevisionVersion = 2
      ModuleId = 120
      SwMajorVersion = 1
      SwMinorVersion = 0
      SwPatchVersion = 2
      VendorId = 43
    DioConfig
      DioPort_PortC (DioPort): DioPortId=2
        Dio_SWT_CCW (DioChannel): DioChannelId=13
        Dio_SWT_CW (DioChannel): DioChannelId=12
      DioPort_PortD (DioPort): DioPortId=3
        Dio_RelayA (DioChannel): DioChannelId=0
        Dio_RelayB (DioChannel): DioChannelId=15
    DioGeneral:
      DioDevErrorDetect = 0
      DioEnableUserModeSupport = 0
      DioFlipChannelApi = 0
      DioMaskedWritePortApi = 0
      DioReadZeroForUndefinedPortPins = 0
      DioReversePortBits = 0
      DioVersionInfoApi = 0
